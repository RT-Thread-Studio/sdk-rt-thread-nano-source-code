## components/finsh/Kconfig
```kconfig
menu "Command shell"

config RT_USING_FINSH
    bool "finsh shell"
    select RT_USING_CONSOLE
    default n

if RT_USING_FINSH

config FINSH_THREAD_NAME
    string "The finsh thread name"
    default "tshell"

config FINSH_USING_SYMTAB
    bool
    default y

config FINSH_USING_DESCRIPTION
    bool "Keeping description in symbol table"
    default y
    
config FINSH_THREAD_PRIORITY
    int "The priority level value of finsh thread"
    default 20

config FINSH_THREAD_STACK_SIZE
    int "The stack size for finsh thread"
    default 4096

config FINSH_CMD_SIZE
    int "The command line size for shell"
    default 80

config FINSH_USING_MSH
    bool
    default y

if FINSH_USING_MSH
config FINSH_USING_MSH_DEFAULT
    bool
    default y
    
config FINSH_USING_MSH_ONLY
    bool
    default y


config FINSH_ARG_MAX
    int "The command arg num for shell"
    default 10
endif

endif

endmenu
```
